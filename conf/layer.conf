## conf/layer.conf
```bitbake
# We have a conf and classes directory, add to BBPATH
BBPATH .= ":${LAYERDIR}"

# We have recipes-* directories, add to BBFILES
BBFILES += "${LAYERDIR}/recipes-*/*/*.bb \
	${LAYERDIR}/recipes-*/*/*.bbappend"

BBFILE_COLLECTIONS += "dpgen"
BBFILE_PATTERN_dpgen = "^${LAYERDIR}/"
BBFILE_PRIORITY_dpgen = "9"
LAYERSERIES_COMPAT_dpgen = "thud"

# It seems I have to declare this to add generator to the binaries directory.
IMAGE_INSTALL_append = " dpgen"
```
